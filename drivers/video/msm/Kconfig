## drivers/video/msm/Kconfig
```kconfig
source "drivers/video/msm/vidc/Kconfig"

config FB_MSM
	tristate
	depends on FB && ARCH_MSM
	select FB_CFB_FILLRECT
	select FB_CFB_COPYAREA
	select FB_CFB_IMAGEBLIT
	default y

config FB_MSM_LCDC
	bool "Support for integrated LCD controller in qsd8x50"
	depends on FB_MSM && MSM_MDP31
	default y

config FB_MSM_VSYNC_ENABLED
        bool "Enable vsync"
        depends on EXPERIMENTAL
        default y
        help
          This option enables/disables the vertical syncronisation of the display driver.

 
```
